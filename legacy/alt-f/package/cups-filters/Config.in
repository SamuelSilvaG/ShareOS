## legacy/alt-f/package/cups-filters/Config.in
```kconfig
config BR2_PACKAGE_CUPS_FILTERS
	bool "cups-filters"
	select BR2_PACKAGE_TIFF
	select BR2_PACKAGE_JPEG
	select BR2_PACKAGE_PNG
	select BR2_PACKAGE_ZLIB
	select BR2_PACKAGE_BZIP2
	select BR2_PACKAGE_FREETYPE
	select BR2_PACKAGE_FONTCONFIG
	select BR2_PACKAGE_LIBERATION
	select BR2_PACKAGE_LCMS2
	select BR2_PACKAGE_LIBGLIB2
	select BR2_PACKAGE_QPDF
	select BR2_PACKAGE_AVAHI
	select BR2_PACKAGE_CUPS
	select BR2_PACKAGE_DBUS
	help
	  This project provides backends, filters, and other software that was once part of the core CUPS distribution but is no longer maintained by Apple Inc.
	  
	  https://github.com/OpenPrinting/cups-filters
```

## legacy/alt-f/package/dns-323-321-compat/Config.in
```kconfig
config BR2_PACKAGE_DNS_323_321_COMPAT
	bool "dns-323-321-compat"
	help
	  Meta package that installs aditional on-disk packages for the DNS-323/321, packages that were previously included in the base firmware
```

## legacy/alt-f/package/mdadm/Config.in
```kconfig
config BR2_PACKAGE_MDADM
	bool "mdadm"
	help
	  Utility for managing RAID hardware.

	  https://kernel.org/pub/linux/utils/raid/mdadm

config BR2_PACKAGE_MDADM_OPTIM
	string "mdadm optim"
	depends on BR2_PACKAGE_MDADM
	help
	  Compile optimization options (-Os, -O2)
```

## legacy/alt-f/package/nmap/Config.in
```kconfig
config BR2_PACKAGE_NMAP
	bool "nmap"
	select BR2_PACKAGE_PCRE
	select BR2_PACKAGE_OPENSSL_COMPAT	
	help
	  Nmap is a free and open source utility for network exploration or security auditing.

	  http://nmap.org
```

## legacy/alt-f/package/opkg-lede/Config.in
```kconfig
comment "opkg needs a toolchain w/ wchar"
	depends on BR2_USE_MMU
	depends on !BR2_USE_WCHAR

config BR2_PACKAGE_OPKG_LEDE
	bool "opkg"
	depends on BR2_USE_MMU # fork()
	depends on BR2_USE_WCHAR # libarchive
	help
	  opkg-lede is opwnwrt fork of Yocto opkg. It is a lightweight package management system, based on ipkg. It is intended for use on embedded Linux devices.

	  https://git.openwrt.org/opkg-lede.git
```

## legacy/alt-f/package/opkg/Config.in
```kconfig
comment "opkg needs a toolchain w/ wchar"
	depends on BR2_USE_MMU
	depends on !BR2_USE_WCHAR

config BR2_PACKAGE_OPKG
	bool "opkg"
	depends on BR2_USE_MMU # fork()
	depends on BR2_USE_WCHAR # libarchive
	select BR2_PACKAGE_LIBARCHIVE
	help
	  Opkg is a lightweight package management system, based on
	  ipkg. It is intended for use on embedded Linux devices.

	  https://www.yoctoproject.org/software-item/opkg
```

## legacy/alt-f/package/sabyenc/Config.in
```kconfig
config BR2_PACKAGE_SABYENC
	bool "sabyenc"
	select BR2_PACKAGE_PYTHON
	help
	  Python yEnc package optimized for use within SABnzbd

	  https://github.com/sabnzbd/sabyenc
```

## legacy/alt-f/package/samba-small/Config.in
```kconfig
config BR2_PACKAGE_SAMBA_SMALL_OLD
	bool "samba-small"
	depends on ! BR2_PACKAGE_SAMBA
	select BR2_PACKAGE_LIBICONV
	select BR2_PACKAGE_POPT
	help
	  Provides (a minimum Samba), file an print services to all manner of SMB/CIFS clients,
	  including the numerous versions of MS-Windows operating systems.

	  http://www.samba.org/

config BR2_PACKAGE_SAMBA_SMALL_OPTIM_OLD
	string "samba optim"
	depends on BR2_PACKAGE_SAMBA_SMALL_OLD
	help
	  Compile optimization options (-Os, -O2)
```

## package/acmesh/Config.in
```kconfig
config BR2_PACKAGE_ACMESH
	bool "acmesh"
	select BR2_PACKAGE_LIGHTTPD
	select BR2_PACKAGE_OPENSSL
	help
	  Simplest shell script for Let's Encrypt free certificate client.

	  https://github.com/acmesh-official/acme.sh
```

## package/cryptography/Config.in
```kconfig
config BR2_PACKAGE_CRYPTOGRAPHY
	bool "cryptography"
	select BR2_PACKAGE_PYTHON
	select BR2_PACKAGE_CFFI
	select BR2_PACKAGE_OPENSSL
	help
	  Provides cryptographic recipes and primitives to Python developers

	  https://pypi.python.org/pypi/cryptography
```

## package/dev-headers-bundle/Config.in
```kconfig
config BR2_PACKAGE_DEV_HEADERS_BUNDLE
	bool "dev-headers-bundle"
	help
	  All libraries header files (complements dev-bundle)
```

## package/dosfstools/Config.in
```kconfig
config BR2_PACKAGE_DOSFSTOOLS
	bool "dosfstools"
	help
	  Tools for creating and checking DOS FAT filesystems.

	  http://sources.buildroot.net

config BR2_PACKAGE_DOSFSTOOLS_OPTIM
	string "dosfstools optim"
	depends on BR2_PACKAGE_DOSFSTOOLS
	help
	  Compile optimization options (-Os, -O2)
```

## package/exfat-linux/Config.in
```kconfig
config BR2_PACKAGE_EXFAT_LINUX
	bool "exfat-linux"
	help
	  exFAT filesystem module for Linux kernel is a backport of the latest Linux mainline's exFAT drivers by Samsung

	  https://github.com/arter97/exfat-linux
```

## package/exfatprogs/Config.in
```kconfig
config BR2_PACKAGE_EXFATPROGS
	bool "exfatprogs"
	help
	  A set of utilities for creating, checking, dumping and labelling exFAT file system.

	  https://github.com/exfatprogs/exfatprogs
```

## package/gmp/Config.in
```kconfig
config BR2_PACKAGE_LIBGMP
	bool "libgmp"
	help
	  GNU Multiple Precision Arithmetic Library.

	  http://gmplib.org/
```

## package/gs/Config.in
```kconfig
config BR2_PACKAGE_GS
	bool "gs"
	select BR2_PACKAGE_CUPS
	select BR2_PACKAGE_TIFF
	select BR2_PACKAGE_JPEG
	select BR2_PACKAGE_LIBPNG
	select BR2_PACKAGE_FONTCONFIG
	select BR2_PACKAGE_BZIP2
	help
	  An interpreter for the PostScript (TM) language and the Adobe Portable Document Format

	  http://pages.cs.wisc.edu/~ghost/doc/GPL/index.htm
```

## package/haveged/Config.in
```kconfig
config BR2_PACKAGE_HAVEGED
	bool "haveged"
	help
	  An entropy source daemon. Easy-to-use, unpredictable random number generator
	  based upon an adaptation of the HAVEGE algorithm

	  https://www.issihosts.com/haveged
```

## package/iperf3/Config.in
```kconfig
config BR2_PACKAGE_IPERF3
	bool "iperf3"
	depends on BR2_INSTALL_LIBSTDCPP
	help
	  Internet Protocol bandwidth measuring tool for measuring
	  TCP/UDP performance.

	  https://github.com/esnet/iperf

comment "iperf requires a toolchain with C++ support enabled"
	depends on !BR2_INSTALL_LIBSTDCPP
```

## package/lcms2/Config.in
```kconfig
config BR2_PACKAGE_LCMS2
	bool "lcms2"
	select BR2_PACKAGE_TIFF
	select BR2_PACKAGE_JPEG
	select BR2_PACKAGE_ZLIB
	help
	  Little Color Management Software (CMS) intends to be an OPEN
	  SOURCE small-footprint color management engine, with special
	  focus on accuracy and performance.
	  It uses the International Color Consortium standard (ICC),
	  which is the modern standard when regarding to color
	  management.

	  http://www.littlecms.com/
```

## package/libubox/Config.in
```kconfig
comment "opkg needs a toolchain w/ wchar"
	depends on BR2_USE_MMU
	depends on !BR2_USE_WCHAR

config BR2_PACKAGE_LIBUBOX
	bool "libubox"
	depends on BR2_USE_MMU # fork()
	depends on BR2_USE_WCHAR # libarchive
	help
	  C utility functions for OpenWrt

	  https://git.openwrt.org/project/libubox.git
```

## package/openssl-compat/Config.in
```kconfig
config BR2_PACKAGE_OPENSSL_COMPAT
	bool "openssl-compat"
	select BR2_PACKAGE_ZLIB
	help
	  Libraries from openssl-1.0.2, needed for binaries incompatible with openssl-1.1.1

	  https://www.openssl.org/
```

## package/pcre2/Config.in
```kconfig
config BR2_PACKAGE_PCRE2
	bool "pcre2"
	help
	  Perl Compatible Regular Expressions

	  http://www.pcre.org/
```

## package/sabnzbd/Config.in
```kconfig
config BR2_PACKAGE_SABNZBD
	bool "sabnzbd"
	select BR2_PACKAGE_PYTHON
	select BR2_PACKAGE_CHEETAH
	select BR2_PACKAGE_SABYENC
	help
	   SABnzbd is an Open Source Binary Newsreader written in Python. (dummy package)

	   http://sabnzbd.org/
```
