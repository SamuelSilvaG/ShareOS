## Config.in
```kconfig
menu "ShareOS"

source "$BR2_EXTERNAL_SHAREOS_PATH/package/alt-f-utils/Config.in"

endmenu

source "$BR2_EXTERNAL_SHAREOS_PATH/package/alt-f-utils/Config.in.host"
```

## package/alt-f-utils/Config.in
```kconfig
config BR2_PACKAGE_ALT_F_UTILS
	bool "alt-f-utils"
	help
	  Device utilities inherited from Alt-F:
	  dns320l-daemon (Weltrend MCU: fan, RTC, power LED, power
	  button, shutdown/WOL), sysctrl (fan/temperature/button control)
	  and dns323-fw (D-Link firmware container tool).

if BR2_PACKAGE_ALT_F_UTILS

config BR2_PACKAGE_ALT_F_UTILS_SYSCTRL
	bool "sysctrl"
	help
	  Alt-F system control daemon. Not needed for the phase-1
	  test system; will be replaced by shareosd modules later.

endif
```

## package/alt-f-utils/Config.in.host
```kconfig
config BR2_PACKAGE_HOST_ALT_F_UTILS
	bool "host alt-f-utils (dns323-fw)"
	help
	  Host build of dns323-fw, used to create firmware images in
	  the D-Link container format that the stock firmware, Alt-F
	  and ShareOS can flash from their web interface.
```

## package/rpcd/Config.in
```kconfig
config BR2_PACKAGE_RPCD
	bool "rpcd"
	depends on BR2_TOOLCHAIN_HAS_SYNC_4 # json-c
	depends on !BR2_STATIC_LIBS # plugins
	select BR2_PACKAGE_LIBUBOX
	select BR2_PACKAGE_UBUS
	select BR2_PACKAGE_UCI
	select BR2_PACKAGE_UCODE
	select BR2_PACKAGE_JSON_C
	help
	  OpenWrt ubus RPC daemon: sessions, ACLs, uci access, file and
	  sys plugins, and ucode plugins (/usr/share/rpcd/ucode/*.uc).
	  The ShareOS web UI talks to it through uhttpd's /ubus endpoint.

	  https://openwrt.org/docs/techref/rpcd
```

## package/shareos-adguardhome/Config.in
```kconfig
config BR2_PACKAGE_SHAREOS_ADGUARDHOME
	bool "shareos-adguardhome"
	depends on BR2_arm
	help
	  AdGuard Home for the system app "dnsfilter" (DNS filter module):
	  the official static linux_armv5 build, checked with its
	  SHA-256 – nothing is compiled.

	  https://github.com/AdguardTeam/AdGuardHome
```

## package/shareos-core/Config.in
```kconfig
config BR2_PACKAGE_SHAREOS_CORE
	bool "shareos-core"
	depends on !BR2_STATIC_LIBS
	select BR2_PACKAGE_UCI
	select BR2_PACKAGE_UBUS
	select BR2_PACKAGE_UCODE
	select BR2_PACKAGE_RPCD
	select BR2_PACKAGE_UHTTPD
	select BR2_PACKAGE_LIBCURL
	select BR2_PACKAGE_LIBCURL_CURL
	select BR2_PACKAGE_CA_CERTIFICATES
	select BR2_PACKAGE_MTD
	select BR2_PACKAGE_ALT_F_UTILS # dns323-fw
	help
	  ShareOS backend: UCI defaults, rpcd ucode plugin (shareos.system,
	  shareos.update), ACLs, init scripts for ubusd/rpcd/uhttpd, the
	  GitHub release updater (shareos-update) and the web root.
```

## package/shareos-syncthing/Config.in
```kconfig
config BR2_PACKAGE_SHAREOS_SYNCTHING
	bool "shareos-syncthing"
	depends on BR2_PACKAGE_HOST_GO_TARGET_ARCH_SUPPORTS
	select BR2_PACKAGE_HOST_GO
	help
	  Syncthing for the system app "syncthing": continuous file
	  synchronisation between devices, without its own web
	  interface (ShareOS uses its REST API).

	  https://syncthing.net/
```

## package/uci/Config.in
```kconfig
config BR2_PACKAGE_UCI
	bool "uci"
	depends on BR2_TOOLCHAIN_HAS_SYNC_4 # libubox -> json-c
	depends on !BR2_STATIC_LIBS
	select BR2_PACKAGE_LIBUBOX
	help
	  OpenWrt Unified Configuration Interface: library and CLI for
	  the /etc/config/* files. ShareOS keeps all settings in UCI.

	  https://openwrt.org/docs/guide-user/base-system/uci
```

## package/ucode/Config.in
```kconfig
config BR2_PACKAGE_UCODE
	bool "ucode"
	depends on BR2_TOOLCHAIN_HAS_SYNC_4 # json-c
	depends on !BR2_STATIC_LIBS # dlopen() of modules
	select BR2_PACKAGE_JSON_C
	select BR2_PACKAGE_LIBUBOX
	select BR2_PACKAGE_UBUS
	select BR2_PACKAGE_UCI
	help
	  Small ECMAScript-like scripting language from OpenWrt, used by
	  the ShareOS backend (rpcd plugins) and its templates. Built
	  with the fs, io, math, struct, log, socket, resolv, uloop,
	  ubus and uci modules.

	  https://ucode.mein.io/
```
